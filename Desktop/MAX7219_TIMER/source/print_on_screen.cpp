#include "variables.h"

PROGMEM const unsigned char CH[] = {
3, 8, B00000000, B00000000, B00000000, B00000000, B00000000, // space
1, 8, B01011111, B00000000, B00000000, B00000000, B00000000, // !
3, 8, B00000011, B00000000, B00000011, B00000000, B00000000, // "
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4, 8, B00001000, B00000100, B00001000, B00000100, B00000000, // ~
};

const unsigned char numberArray[11][7] = 
{
  {4, 8, B00111110, B01000001, B01000001, B00111110, B00000000}, // 0
  {3, 8, B01000010, B01111111, B01000000, B00000000, B00000000}, // 1
  {4, 8, B01100010, B01010001, B01001001, B01000110, B00000000}, // 2
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  {2, 8, B01010000, B00000000, B00000000, B00000000, B00000000} // :}
};

const unsigned char space[] = {3, 8, B00000000, B00000000, B00000000, B00000000, B00000000};

const unsigned char temp[10][7]
{
 {5, 8, B00000001, B00000001, B01111111, B00000001, B00000001}, //T
 {4, 8, B00111000, B01010100, B01010100, B00011000, B00000000}, //e
 {5, 8, B01111100, B00000100, B01111100, B00000100, B01111000}, //m
 {4, 8, B11111100, B00100100, B00100100, B00011000, B00000000}, //p
 {3, 8, B00010100, B00010100, B00010100, B00000000, B00000000}, //=
 {4, 8, B00111000, B01000100, B01000100, B00111000, B00000000}, //o
 {4, 8, B00111110, B01000001, B01000001, B00100010, B00000000}  //C
};

extern MaxMatrix m; // define Library
extern DHT dht; //// Initialize DHT sensor for normal 16mhz Arduino

float temper; //Stores temperature value
char str[] = "Latmos Electronics";  // Scrolling Text

/*This function is used for printing the current hour on the screen*/
void write_on_screen(int hours,int minutes,int seconds)
{
    convert_hours(hours);
    convert_minutes(minutes);
    convert_seconds(seconds);
    
    int j = 2;
    
    if (hours < 10 ){
      
       m.writeSprite(0+j, 0, numberArray[0] );//always displays 0 on the screen  
       m.writeSprite(5+j, 0, numberArray[final_h[0]] );//2nd digit of hour
    
    }else{
       
       m.writeSprite(0+j, 0, numberArray[final_h[0]] );//1st digit of hour
       m.writeSprite(5+j, 0, numberArray[final_h[1]] );//2nd digit of hour 
    
    }
    
    m.writeSprite(10+j,-2, numberArray[10] ); // dotts
    
    if (minutes < 10){
      
      m.writeSprite(12+j,0, numberArray[0] );//1st digit of minutes
      m.writeSprite(17+j, 0, numberArray[final_m[0]] );//2nd digit of minutes
    
    }else{
 
    m.writeSprite(12+j,0, numberArray[final_m[0]] );//1st digit of minutes
    m.writeSprite(17+j, 0, numberArray[final_m[1]] );//2nd digit of minutes
    
    }
    m.writeSprite(22+j,-2, numberArray[10] );// dotts
    
    if (seconds < 10)
    {
      m.writeSprite(24+j,0, numberArray[0] );//displays the 1st digit of seconds and it is always zero in the first 10 seconds
      
      if (final_s[0] == 1){
        
         m.writeSprite(34, 0, space );
      }
      
      m.writeSprite(29+j, 0, numberArray[final_s[0]] );//2nd digit of seconds     
    
    }else{
         
          m.writeSprite(24+j,0, numberArray[final_s[0]] );//1st digit of seconds after the first 10 seconds
         
         if (final_s[0] == 1)
         {
            m.writeSprite(27+j,0, space);//fix the problem with 1
         }
         
         m.writeSprite(29+j, 0, numberArray[final_s[1]] );//2nd digit of seconds after the first 10 seconds
         
         if (final_s[1] == 1)
         {
            m.writeSprite(32+j,0, space);//fix the problem with 1
         }
   }
}

/*This function is used for printing strings on the screen*/
void printString()
{
   if (counter == 0){
     m.clear();
     m.shiftLeft(false, true);
     printStringWithShift(str, 50);  // Send scrolling Text
     m.clear();
     convert_hours(temper);
        m.writeSprite(1,0,temp[0]);
        m.writeSprite(6,0,temp[4]);
        m.writeSprite(16,0,numberArray[(int)temper]); 
     if (temper < 10){
        m.writeSprite(11, 0, numberArray[0]);
        m.writeSprite(16,0,numberArray[(int)temper]);
     }else{
        m.writeSprite(11, 0, numberArray[final_h[0]]);
        m.writeSprite(16, 0, numberArray[final_h[1]]);
     }
     m.writeSprite(21,-2,temp[5]);
     m.writeSprite(26,0,temp[6]);
     delay(3000);
     m.clear();
     }
}

// Put extracted character on Display
void printCharWithShift(char c, int shift_speed){
  if (c < 32) return;
  c -= 32;
  memcpy_P(buffer, CH + 7*c, 7);
  m.writeSprite(maxInUse*8, 0, buffer);
  m.setColumn(maxInUse*8 + buffer[0], 0);
  
  for (int i=0; i<buffer[0]+1; i++) 
  {
    delay(shift_speed);
    m.shiftLeft(false, false);
  }
}
 
// Extract characters from Scrolling text
void printStringWithShift(char* s, int shift_speed){
  while (*s != 0){
    printCharWithShift(*s, shift_speed);
    s++;
  }
}
